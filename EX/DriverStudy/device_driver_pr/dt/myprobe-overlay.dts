/dts-v1/;
/plugin/;

/ {
    compatible = "brcm,bcm2711";

    fragment@0 {
        target = <&soc>;

        __overlay__ {
            mytest: mytest {
                compatible = "test,myprobe";
                status = "okay";
            };
        };
    };
};

